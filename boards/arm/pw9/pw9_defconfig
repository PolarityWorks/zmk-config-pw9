## boards/arm/pw9/pw9_defconfig
```kconfig
# SPDX-License-Identifier: MIT

CONFIG_SOC_SERIES_RP2XXX=y
CONFIG_SOC_RP2040=y
CONFIG_SYS_CLOCK_HW_CYCLES_PER_SEC=125000000
CONFIG_BOARD_PW9=y

# enable GPIO
CONFIG_GPIO=y

CONFIG_ZMK_KSCAN_MATRIX_WAIT_BEFORE_INPUTS=1
CONFIG_ZMK_KSCAN_MATRIX_WAIT_BETWEEN_OUTPUTS=1

# encoder
CONFIG_EC11=y
CONFIG_EC11_TRIGGER_GLOBAL_THREAD=y

CONFIG_USE_DT_CODE_PARTITION=y

CONFIG_RESET=y

CONFIG_BUILD_OUTPUT_UF2=y
```

## config/west.yml
```yaml
manifest:
  remotes:
    - name: zmkfirmware
      url-base: https://github.com/zmkfirmware
  projects:
    - name: zmk
      remote: zmkfirmware
      revision: main
      import: app/west.yml
    - name: keysmash
      url: https://github.com/ReFil/refil-zmk-behaviour-modules
      revision: keysmash
    - name: awawa
      url: https://github.com/ReFil/refil-zmk-behaviour-modules
      revision: awawa
  self:
    path: config
```
